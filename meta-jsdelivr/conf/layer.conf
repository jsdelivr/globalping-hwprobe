## meta-jsdelivr/conf/layer.conf
```bitbake
# We have a conf and classes directory, add to BBPATH
BBPATH .= ":${LAYERDIR}"

# We have recipes-* directories, add to BBFILES
BBFILES += "${LAYERDIR}/recipes-*/*/*.bb ${LAYERDIR}/recipes-*/*/*.bbappend"

BBFILE_COLLECTIONS += "jsdelivr"
BBFILE_PATTERN_jsdelivr = "^${LAYERDIR}/"
BBFILE_PRIORITY_jsdelivr = "11"


# This should only be incremented on significant changes that will
# cause compatibility issues with other layers
LAYERVERSION_jsdelivr = "1"

LAYERDEPENDS_jsdelivr = "core"

LAYERSERIES_COMPAT_jsdelivr = "honister kirkstone"
```

## meta-nanopi-zero2/conf/layer.conf
```bitbake
# We have a conf and classes directory, add to BBPATH
BBPATH .= ":${LAYERDIR}"

# We have recipes-* directories, add to BBFILES
BBFILES += "${LAYERDIR}/recipes-*/*/*.bb \
            ${LAYERDIR}/recipes-*/*/*.bbappend"

BBFILE_COLLECTIONS += "nanopi-zero2"
BBFILE_PATTERN_nanopi-zero2 = "^${LAYERDIR}/"
BBFILE_PRIORITY_nanopi-zero2 = "10"

LAYERDEPENDS_nanopi-zero2 = "core rockchip"
LAYERSERIES_COMPAT_nanopi-zero2 = "scarthgap styhead"
```

## meta-nanopi-zero2/conf/local.conf.sample
```bitbake
#
# NanoPi Zero2 Yocto Build Configuration
# Copy this file to build/conf/local.conf
#

# =============================================================================
# Machine Selection
# =============================================================================
MACHINE ??= "nanopi-zero2"

# =============================================================================
# Distribution Configuration
# =============================================================================
DISTRO ?= "poky"
CONF_VERSION = "2"

# =============================================================================
# Build Performance
# =============================================================================
# Adjust these based on your build machine capabilities
BB_NUMBER_THREADS = "7"
PARALLEL_MAKE = "-j 7"

# Remove work directories after build to save disk space
INHERIT += "rm_work"

# Disk space monitoring
BB_DISKMON_DIRS ??= "\
    STOPTASKS,${TMPDIR},1G,100K \
    STOPTASKS,${DL_DIR},1G,100K \
    STOPTASKS,${SSTATE_DIR},1G,100K \
    STOPTASKS,/tmp,100M,100K \
    HALT,${TMPDIR},100M,1K \
    HALT,${DL_DIR},100M,1K \
    HALT,${SSTATE_DIR},100M,1K \
    HALT,/tmp,10M,1K"

# =============================================================================
# Init System - systemd
# =============================================================================
DISTRO_FEATURES:append = " systemd usrmerge virtualization"
DISTRO_FEATURES:remove = " sysvinit"

VIRTUAL-RUNTIME_init_manager = "systemd"
VIRTUAL-RUNTIME_udev = "systemd"

# Avoid sysv backfill noise
DISTRO_FEATURES_BACKFILL_CONSIDERED:append = " sysvinit"
VIRTUAL-RUNTIME_initscripts = ""

# =============================================================================
# Image Features
# =============================================================================
# debug-tweaks: SSH root access with blank password
# read-only-rootfs: Immutable root filesystem for reliability
EXTRA_IMAGE_FEATURES ?= "debug-tweaks"
EXTRA_IMAGE_FEATURES += "read-only-rootfs"

# Volatile logs - stored in tmpfs, lost on reboot
VOLATILE_LOG_DIR = "yes"

# Support for read-only rootfs volatile binds
IMAGE_INSTALL:append = " volatile-binds"

# Build statistics
USER_CLASSES ?= "buildstats"

# Disable interactive patch resolution
PATCHRESOLVE = "noop"

# QEMU configuration
PACKAGECONFIG:append:pn-qemu-system-native = " sdl"

# =============================================================================
# Container Runtime (Docker)
# =============================================================================
IMAGE_INSTALL:append = " docker tini iptables ca-certificates"
IMAGE_INSTALL:append = " skopeo"

# =============================================================================
# Globalping Hardware Probe
# =============================================================================
# Base container (mandatory)
IMAGE_INSTALL:append = " jsdelivr-service jsdelivr-scripts jsdelivr-configure jsdelivr-basecontainer"

# Optional containers management system
IMAGE_INSTALL:append = " jsdelivr-container-manager jsdelivr-optional-containers"

# Optional container frozen images (crowdsec, netdata, wireguard)
IMAGE_INSTALL:append = " jsdelivr-container-crowdsec jsdelivr-container-netdata jsdelivr-container-wireguard"

# =============================================================================
# System Utilities
# =============================================================================
# Filesystem and network
IMAGE_INSTALL:append = " e2fsprogs curl parted"

# SSH client and server
IMAGE_INSTALL:append = " openssh-ssh openssh-sshd openssh-sftp-server openssh-scp"

# CPU frequency scaling
IMAGE_INSTALL:append = " cpufrequtils"

# Hardware tools for eMMC/SD management
IMAGE_INSTALL:append = " mmc-utils fio"

# Diagnostic tools
IMAGE_INSTALL:append = " strace htop mc lsof nano jq"

# Python runtime
IMAGE_INSTALL:append = " python3-core python3-flask"

# =============================================================================
# Debug User Configuration
# =============================================================================
# Create a 'debug' user with password 'password' for SSH access
INHERIT += "extrausers"
EXTRA_USERS_PARAMS = "\
    useradd -p '$(openssl passwd -6 password)' debug; \
    usermod -a -G sudo debug; \
"
```

## meta-nanopi-zero2/conf/machine/include/rk3528.inc
```bitbake
# RK3528 SoC configuration
# Rockchip RK3528A Quad-core ARM Cortex-A53 @ 2.0GHz

SOC_FAMILY = "rk3528"

DEFAULTTUNE ?= "cortexa53-crypto"

require conf/machine/include/soc-family.inc
require conf/machine/include/rockchip-defaults.inc
require conf/machine/include/arm/armv8a/tune-cortexa53.inc
require conf/machine/include/rockchip-wic.inc

KBUILD_DEFCONFIG ?= "nanopi5_linux_defconfig"
KERNEL_CLASSES = "kernel-fitimage"
KERNEL_IMAGETYPE ?= "fitImage"

SERIAL_CONSOLES = "1500000;ttyFIQ0"

# TFA Platform
TFA_PLATFORM = "rk3528"
TFA_BUILD_TARGET = "bl31"

UBOOT_SUFFIX ?= "itb"
UBOOT_ENTRYPOINT ?= "0x06000000"

ENABLE_STATELESS_VPU_GST ?= "1"
```

## meta-nanopi-zero2/conf/machine/nanopi-zero2.conf
```bitbake
#@TYPE: Machine
#@NAME: NanoPi Zero2
#@DESCRIPTION: FriendlyElec NanoPi Zero2 - Rockchip RK3528A based board with Gigabit Ethernet, USB, and M.2 WiFi support
#https://www.friendlyelec.com/index.php?route=product/product&product_id=304

require conf/machine/include/rk3528.inc

# Use FriendlyElec kernel and U-Boot
PREFERRED_PROVIDER_virtual/kernel = "linux-friendlyarm"
PREFERRED_PROVIDER_virtual/bootloader = "u-boot-nanopi-zero2-prebuilt"
PREFERRED_VERSION_linux-friendlyarm = "6.1%"
# U-Boot: Using pre-built binaries due to 2017.09 compatibility issues with modern Yocto
# See meta-nanopi-zero2/recipes-bsp/u-boot/files/README-uboot-binaries.txt

# Use proper RK3528 device tree from FriendlyElec kernel
KERNEL_DEVICETREE = "rockchip/rk3528-nanopi-rev01.dtb"

# Use plain kernel Image instead of FIT image for old U-Boot 2017.09
KERNEL_IMAGETYPE = "Image"
KERNEL_IMAGETYPES = "Image"

# Include kernel modules (use RDEPENDS for core-image-minimal compatibility)
MACHINE_ESSENTIAL_EXTRA_RDEPENDS += "kernel-modules"

# U-Boot configuration - use FriendlyElec's defconfig
UBOOT_MACHINE = "nanopi5_defconfig"

# Board-specific features
MACHINE_FEATURES += "pci"

# WiFi firmware (for optional M.2 WiFi module)
MACHINE_EXTRA_RRECOMMENDS += "linux-firmware-rtl8821"

# WIC configuration - Use A/B partition layout for RAUC OTA updates
# nanopi-zero2-ab.wks: Dual rootfs (rootfs-a, rootfs-b) for RAUC
# nanopi-zero2-single.wks: Original single rootfs layout (backup)
WKS_FILE = "nanopi-zero2-ab.wks"

# Image types - ext4 needed for RAUC bundles
IMAGE_FSTYPES:append = " ext4"
```

## meta-nanopi-zero2/wic/nanopi-zero2-ab.wks
```
# Copyright (C) 2025
# Released under the MIT license
#
# short-description: Create A/B disk image for NanoPi Zero2 (RK3528) with RAUC OTA support
# long-description: Creates a disk image with dual rootfs partitions for A/B updates
#
# Disk layout for RK3528 with RAUC A/B support:
#
#   Partition   Start Sector    Size            Name        Flags
#   loader1     64              3552K           loader1     (idbloader / U-Boot SPL)
#   loader2     16384           4096K           loader2     (uboot.img - FIT image)
#   rootfs-a    32768           2G              rootfs-a    legacy_boot (active slot)
#   rootfs-b    auto            2G              rootfs-b    (inactive slot)
#   persist     auto            50M             persist     (boot state, RAUC config)
#   [docker partitions created dynamically by firstBoot.sh]
#
# Boot Selection Mechanism:
#   - U-Boot scans partitions with legacy_boot flag first
#   - Active slot has legacy_boot flag set (--active in WKS)
#   - RAUC toggles legacy_boot flag to switch slots:
#     parted -s /dev/mmcblk2 set 3 legacy_boot on/off
#     parted -s /dev/mmcblk2 set 4 legacy_boot on/off
#
# Each rootfs partition contains its own /boot/extlinux/extlinux.conf
# pointing to its own PARTLABEL (rootfs-a or rootfs-b)
#

# Bootloader partitions (unchanged from single-rootfs layout)
part loader1   --offset 64s    --fixed-size 3552K --fstype=none --part-name loader1   --source rawcopy --sourceparams="file=idbloader.img"
part loader2   --offset 16384s --fixed-size 4096K --fstype=none --part-name loader2   --source rawcopy --sourceparams="file=uboot.img"

# Slot A - Active rootfs with legacy_boot flag
# --active sets the GPT legacy_boot attribute that U-Boot looks for
part /         --offset 32768s --fixed-size 3G --fstype=ext4 --label rootfs-a --part-name rootfs-a --active --source rootfs --no-fstab-update

# Slot B - Inactive rootfs (populated by first RAUC update)
# No --active flag, so no legacy_boot attribute
part           --fixed-size 3G --fstype=ext4 --label rootfs-b --part-name rootfs-b

# Persistent data partition (for boot state, RAUC status, etc.)
part /persist  --fixed-size 50M --fstype=ext4 --label persist --part-name persist

# Docker partitions are created dynamically by firstBoot.sh using remaining space

bootloader --ptable gpt
```

## meta-nanopi-zero2/wic/nanopi-zero2-single.wks
```
# Copyright (C) 2025
# Released under the MIT license
#
# short-description: Create a disk image suitable for booting NanoPi Zero2 (RK3528) from SD-card
# long-description: Creates a disk image partitioned using GPT, suitable for RK3528
#
# Disk layout for RK3528 (FriendlyElec U-Boot 2017.09)
# FriendlyElec's U-Boot uses a single FIT image (uboot.img) at loader2 position
# that contains U-Boot + ATF + OP-TEE combined
#
# Fully read-only rootfs configuration - all volatile data in tmpfs (RAM)
# Docker images and container data will NOT persist across reboots
#
#   Partition   Start Sector    Number of Sectors
#   loader1     64              7104        (idbloader / U-Boot SPL)
#   reserved    7168            8128        (reserved space)
#   loader2     16384           8192        (uboot.img - FIT image with U-Boot+ATF+OP-TEE)
#   root        32768           ~2097152    (read-only rootfs - 1GB, everything in tmpfs)
#   persist     auto            ~102400     (persistent storage - 50MB, read-only by default, remount RW to update)
#   docker      auto            (created at first boot - Docker storage)
#   docker_persist auto         (created at first boot - Container volumes)

part loader1   --offset 64s    --fixed-size 3552K --fstype=none --part-name loader1   --source rawcopy --sourceparams="file=idbloader.img"
part loader2   --offset 16384s --fixed-size 4096K --fstype=none --part-name loader2   --source rawcopy --sourceparams="file=uboot.img"
part /         --offset 32768s --size 1G --label rootfs  --active           --fstype=ext4 --part-name rootfs    --source rootfs --no-fstab-update
part /persist  --size 50M --label persist --fstype=ext4 --part-name persist

bootloader --ptable gpt
```
